## conf/layer.conf
```bitbake
#
# If not stated otherwise in this file or this component's LICENSE file the
# following copyright and licenses apply:
#
# Copyright 2019-2020 Liberty Global B.V.
#
# Licensed under the Apache License, Version 2.0 (the "License");
# you may not use this file except in compliance with the License.
# You may obtain a copy of the License at
#
# http://www.apache.org/licenses/LICENSE-2.0
#
# Unless required by applicable law or agreed to in writing, software
# distributed under the License is distributed on an "AS IS" BASIS,
# WITHOUT WARRANTIES OR CONDITIONS OF ANY KIND, either express or implied.
# See the License for the specific language governing permissions and
# limitations under the License.
#
# Author: Damian Wrobel <dwrobel@ertelnet.rybnik.pl>
#

# We have a conf and classes directory, append to BBPATH
BBPATH .= ":${LAYERDIR}"

# We have a recipes directory, add to BBFILES
BBFILES += "${LAYERDIR}/recipes-*/*/*.bb ${LAYERDIR}/recipes-*/*/*.bbappend"
BBFILES += "${LAYERDIR}/meta*/meta*/*/*.bb ${LAYERDIR}/meta*/meta*/*/*.bbappend"
BBFILES += "${LAYERDIR}/meta*/meta*/meta*/*/*.bb ${LAYERDIR}/meta*/meta*/meta*/*/*.bbappend"

BBFILE_COLLECTIONS += "rdk-flutter"
BBFILE_PATTERN_rdk-flutter := "^${LAYERDIR}/"
BBFILE_PRIORITY_rdk-flutter = "7"
LAYERSERIES_COMPAT_rdk-flutter = "dunfell"

LAYERVERSION_rdk-flutter-layer = "1"

LAYERDEPENDS_rdk-flutter-layer = "clang-layer core openembedded-layer"
```
